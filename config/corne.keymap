/*
 * Copyright (c) 2020 The ZMK Contributors
 *
 * SPDX-License-Identifier: MIT
 */

#include <behaviors.dtsi>
#include <dt-bindings/zmk/keys.h>
#include <dt-bindings/zmk/bt.h>
#include "zmk-helpers/helper.h" // à garder après #include <behaviors.dtsi>
#include "zmk-helpers/key-labels/36.h" // key-position labels
#define ZMK_HELPER_KEEP_NATIVE 1 // pour garder les ZMK_MACRO natives
#include "mouse.dtsi" // mouse emulation



#define QUICK_TAP_MS 175 // 175 valeur d’Urob

#define MO_TOG(layer) &mo_tog layer layer   // Macro to apply momentary-layer-on-hold/toggle-layer-on-tap to a specific layer

#define XXX &none
#define ___ &trans
#define c_Divide &kp RA(L)
#define c_Substract &kp RA(K)
#define c_Comma &kp DOT
#define c_Dot &kp N
#define c_Plus &kp RA(J)
#define c_fine_sp &kp LS(SPACE)


/* Homerow mods */

#define KEYS_L LT0 LT1 LT2 LT3 LT4 LM0 LM1 LM2 LM3 LM4 LB0 LB1 LB2 LB3 LB4
#define KEYS_R RT0 RT1 RT2 RT3 RT4 RM0 RM1 RM2 RM3 RM4 RB0 RB1 RB2 RB3 RB4
#define THUMBS LH2 LH1 LH0 RH0 RH1 RH2

#define MAKE_HRM(NAME, HOLD, TAP, TRIGGER_POS)                                 \
  ZMK_HOLD_TAP(NAME, bindings = <HOLD>, <TAP>; flavor = "balanced";            \
               tapping-term-ms = <280>; quick-tap-ms = <QUICK_TAP_MS>;         \
               require-prior-idle-ms = <150>; hold-trigger-on-release;         \
               hold-trigger-key-positions = <TRIGGER_POS>;)

MAKE_HRM(hml, &kp, &kp, KEYS_R THUMBS) // Left-hand HRMs.
MAKE_HRM(hmr, &kp, &kp, KEYS_L THUMBS) // Right-hand HRMs.

// Hack: Make HRM combos tap-only (cf, ZMK issue #544).
#define ZMK_COMBO_8(NAME, TAP, POS, LAYERS, COMBO_MS, IDLE_MS, HOLD, SIDE)     \
  MAKE_HRM(hm_combo_##NAME, &kp, TAP, SIDE THUMBS)                             \
  ZMK_COMBO_6(NAME, &hm_combo_##NAME HOLD 0, POS, LAYERS, COMBO_MS, IDLE_MS)

/ {
    chosen {
        zmk,physical-layout = &foostan_corne_5col_layout;
    };

    behaviors {
        as: auto_shift {
            compatible = "zmk,behavior-hold-tap";
            #binding-cells = <2>;
            tapping_term_ms = <200>;
            quick_tap_ms = <0>;
            flavor = "tap-preferred";
            bindings = <&kp>, <&kp>;
        };
    };

   behaviors {
        bhm: balanced_homerow_mods {
            compatible = "zmk,behavior-hold-tap";
            #binding-cells = <2>;
            tapping-term-ms = <200>;    // <---[[moderate duration]]
            quick-tap-ms = <0>;
            flavor = "balanced";
            bindings = <&kp>, <&kp>;
        };
    };

    /* momentary-layer when the keybind is held and a toggle-layer when it is tapped (https://zmk.dev/docs/keymaps/behaviors/hold-tap?examples=mo_tog#example-use-cases) */

    behaviors {
        mo_tog: behavior_mo_tog {
            compatible = "zmk,behavior-hold-tap";
            #binding-cells = <2>;
            flavor = "hold-preferred";
            tapping-term-ms = <200>;
            bindings = <&mo>, <&tog>;
        };
    };

// Left-hand home row mods
#define HOME_A &hml LGUI A
#define HOME_S &hml LALT S
#define HOME_D &hml LCTRL D
#define HOME_F &hml LSHIFT F    // if used

// Right-hand home row mods
#define HOME_J &hmr RSHIFT J    // if used
#define HOME_K &hmr RCTRL K
#define HOME_L &hmr LALT L 
#define HOME_SMCLN &hmr RGUI SEMICOLON


        keymap {
                compatible = "zmk,keymap";

                default_layer {    // ---Layer 0---
                        display-name = "Base";
                        bindings = <
//╭─────────────┬─────────────┬─────────────┬─────────────┬─────────────╮ ╭─────────────┬─────────────┬─────────────┬─────────────┬─────────────╮
    &kp Q         &kp W         &kp E         &kp R         &kp T           &kp Y         &kp U         &kp I         &kp O         &kp P        
//├─────────────┼─────────────┼─────────────┼─────────────┼─────────────┤ ├─────────────┼─────────────┼─────────────┼─────────────┼─────────────┤
    HOME_A        HOME_S        HOME_D        HOME_F        &kp G           &kp H         HOME_J        HOME_K        HOME_L        HOME_SMCLN
//├─────────────┼─────────────┼─────────────┼─────────────┼─────────────┤ ├─────────────┼─────────────┼─────────────┼─────────────┼─────────────┤
    &kp Z         &kp X         &kp C         &kp V         &kp B           &kp N         &kp M         &kp COMMA     &kp DOT       &kp SLASH
//╰─────────────┼─────────────┴─────────────┼─────────────┼─────────────┤ ├─────────────┼─────────────┼─────────────┴───────────────────────────╯
                                MO_TOG(1)     &kp LSHIFT    &lt 1 BSPC      &lt 1 SPACE   &lt 2 RET     MO_TOG(5)
//                            ╰─────────────┴─────────────┴─────────────╯ ╰─────────────┴─────────────┴─────────────╯
                        >;
                };

                nav_layer {    // ---Layer 1---
                        display-name = "Nav";
                        bindings = <
//╭─────────────┬─────────────┬─────────────┬─────────────┬─────────────╮ ╭─────────────┬─────────────┬─────────────┬─────────────┬─────────────╮
    &kp TAB       &kp HOME      &kp UP        &kp END       &kp PAGE_UP     c_Substract   &kp KP_N7     &kp KP_N8    &kp KP_N9      c_Plus       
//├─────────────┼─────────────┼─────────────┼─────────────┼─────────────┤ ├─────────────┼─────────────┼─────────────┼─────────────┼─────────────┤
    &kp CAPS      &kp LEFT      &kp DOWN      &kp RIGHT     &kp PAGE_DOWN   c_Divide  &hmr RSHIFT KP_N4  &hmr RCTRL KP_N5  &hmr LALT KP_N6  &hmr RGUI KP_N0     
//├─────────────┼─────────────┼─────────────┼─────────────┼─────────────┤ ├─────────────┼─────────────┼─────────────┼─────────────┼─────────────┤
    &lt 3 C_PP    &kp K_VOL_DN  &kp K_MUTE    &kp K_VOL_UP  &kp LS(TAB)     c_Comma       &kp KP_N1     &kp KP_N2     &kp KP_N3     c_fine_sp      // C_PP: Play / Pause (Consumer)
//╰─────────────┼─────────────┴─────────────┼─────────────┼─────────────┤ ├─────────────┼─────────────┼─────────────┴───────────────────────────╯
                                &tog 1      &bhm LSHIFT ESC &lt 4 DELETE    &lt 4 SPACE   &kp RET       &tog 1          
//                            ╰─────────────┴─────────────┴─────────────╯ ╰─────────────┴─────────────┴─────────────╯
                        >;
                };

                symbols_layer {    // ---Layer 2---
                        display-name = "Symbols";
                        bindings = <
//╭─────────────┬─────────────┬─────────────┬─────────────┬─────────────╮ ╭─────────────┬─────────────┬─────────────┬─────────────┬─────────────╮
    &kp RA(Q)     &kp RA(W)     &kp RA(E)     &kp RA(R)     &kp RA(T)       &kp RA(Y)     &kp RA(U)     &kp RA(I)     &kp RA(O)     &kp RA(P)        
//├─────────────┼─────────────┼─────────────┼─────────────┼─────────────┤ ├─────────────┼─────────────┼─────────────┼─────────────┼─────────────┤
    &kp RA(A)     &kp RA(S)     &kp RA(D)     &kp RA(F)     &kp RA(G)       &kp RA(H)     &kp RA(J)     &kp RA(K)      &kp RA(L)     &kp RA(SEMICOLON)
//├─────────────┼─────────────┼─────────────┼─────────────┼─────────────┤ ├─────────────┼─────────────┼─────────────┼─────────────┼─────────────┤
    &kp RA(Z)     &kp RA(X)     &kp RA(C)     &kp RA(V)     &kp RA(B)       &kp RA(N)     &kp RA(M)     &kp RA(COMMA) &kp RA(DOT)   &kp RA(SLASH)
//╰─────────────┼─────────────┴─────────────┼─────────────┼─────────────┤ ├─────────────┼─────────────┼─────────────┴───────────────────────────╯
                                ___           ___           &kp BSPC        &kp SPACE     ___           ___
//                            ╰─────────────┴─────────────┴─────────────╯ ╰─────────────┴─────────────┴─────────────╯
                        >;
                };

                function_layer {    // ---Layer 3---
                        display-name = "Bluetooth_and_Functions";
                        bindings = <
//╭─────────────┬─────────────┬─────────────┬─────────────┬─────────────╮ ╭─────────────┬─────────────┬─────────────┬─────────────┬─────────────╮
    XXX           XXX           XXX           XXX           &bt BT_CLR      XXX           &kp F7        &kp F8        &kp F9        &kp F12
//├─────────────┼─────────────┼─────────────┼─────────────┼─────────────┤ ├─────────────┼─────────────┼─────────────┼─────────────┼─────────────┤
    &bt BT_SEL 0  &bt BT_SEL 1  &bt BT_SEL 2  &bt BT_SEL 3  &bt BT_SEL 4    XXX           &kp F6        &kp F5        &kp F6        &kp F11
//├─────────────┼─────────────┼─────────────┼─────────────┼─────────────┤ ├─────────────┼─────────────┼─────────────┼─────────────┼─────────────┤
    XXX           XXX           XXX           XXX           XXX             XXX           &kp F1        &kp F2        &kp F3        &kp F10
//╰─────────────┼─────────────┴─────────────┼─────────────┼─────────────┤ ├─────────────┼─────────────┼─────────────┴───────────────────────────╯
                                ___           ___           ___             ___           ___           ___          
//                            ╰─────────────┴─────────────┴─────────────╯ ╰─────────────┴─────────────┴─────────────╯
                        >;
                };

                numbers_row_layer {    // ---Layer 4---
                        display-name = "Modified_numbers'-row";
                        bindings = <
//╭─────────────┬─────────────┬─────────────┬─────────────┬─────────────╮ ╭─────────────┬─────────────┬─────────────┬─────────────┬─────────────╮
    &kp RA(LS(N1)) &kp RA(LS(N2)) &kp RA(LS(N3)) &kp RA(LS(N4)) &kp RA(LS(N5)) &kp RA(LS(N6)) &kp RA(LS(N7)) &kp RA(LS(N8)) &kp RA(LS(N9)) &kp RA(LS(N0))
//├─────────────┼─────────────┼─────────────┼─────────────┼─────────────┤ ├─────────────┼─────────────┼─────────────┼─────────────┼─────────────┤
    &kp LS(N1)    &kp LS(N2)    &kp LS(N3)   &kp LS(N4)    &kp LS(N5)      &kp LS(N6)    &kp LS(N7)    &kp LS(N8)    &kp LS(N9)    &kp LS(N0)
//├─────────────┼─────────────┼─────────────┼─────────────┼─────────────┤ ├─────────────┼─────────────┼─────────────┼─────────────┼─────────────┤
    &kp RA(N1)    &kp RA(N2)     &kp RA(N3)   &kp RA(N4)    &kp RA(N5)      &kp RA(N6)    &kp RA(N7)    &kp RA(N8)    &kp RA(N9)    &kp RA(N0)
//╰─────────────┼─────────────┴─────────────┼─────────────┼─────────────┤ ├─────────────┼─────────────┼─────────────┴───────────────────────────╯
                                ___           ___           ___             ___           ___           ___          
//                            ╰─────────────┴─────────────┴─────────────╯ ╰─────────────┴─────────────┴─────────────╯
                        >;
                };


                mouse_layer {    // ---Layer 5---
                        display-name = "Mouse";
                        bindings = <
//╭─────────────┬─────────────┬─────────────┬─────────────┬─────────────╮ ╭─────────────┬─────────────┬─────────────┬─────────────┬─────────────╮
    &kp PG_UP     U_WH_U        U_MS_U        U_WH_D        &kp PG_DN       &kp PG_UP     U_WH_U        U_MS_U        U_WH_D        &kp PG_DN
//├─────────────┼─────────────┼─────────────┼─────────────┼─────────────┤ ├─────────────┼─────────────┼─────────────┼─────────────┼─────────────┤
    U_WH_L        U_MS_L        U_MS_D        U_MS_R        U_WH_R          U_WH_L        U_MS_L        U_MS_D        U_MS_R        U_WH_R
//├─────────────┼─────────────┼─────────────┼─────────────┼─────────────┤ ├─────────────┼─────────────┼─────────────┼─────────────┼─────────────┤
   &kp C_AL_FILES &mkp LCLK     &mkp MCLK      &mkp RCLK    &kp C_AL_CALC  &kp C_AL_FILES &mkp LCLK     &mkp MCLK      &mkp RCLK    &kp C_AL_CALC
//╰─────────────┼─────────────┴─────────────┼─────────────┼─────────────┤ ├─────────────┼─────────────┼─────────────┴───────────────────────────╯
                                &tog 5        ___           ___             ___           ___           &tog 5         
//                            ╰─────────────┴─────────────┴─────────────╯ ╰─────────────┴─────────────┴─────────────╯
                        >;
                };

        };
};
